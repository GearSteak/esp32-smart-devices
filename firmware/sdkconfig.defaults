## firmware/sdkconfig.defaults
```kconfig
# ESP32 Smart Translator - Main Device
# Default configuration

# Enable BLE (NimBLE)
CONFIG_BT_ENABLED=y
CONFIG_BT_NIMBLE_ENABLED=y
CONFIG_BT_NIMBLE_MAX_CONNECTIONS=3
CONFIG_BT_NIMBLE_ROLE_CENTRAL=y
CONFIG_BT_NIMBLE_ROLE_PERIPHERAL=n
CONFIG_BT_NIMBLE_ROLE_BROADCASTER=n
CONFIG_BT_NIMBLE_ROLE_OBSERVER=y

# Increase task stack sizes for BLE
CONFIG_BT_NIMBLE_TASK_STACK_SIZE=4096

# Flash size
CONFIG_ESPTOOLPY_FLASHSIZE_4MB=y

# Logging
CONFIG_LOG_DEFAULT_LEVEL_INFO=y

# FreeRTOS
CONFIG_FREERTOS_HZ=1000
```

## partner-test-firmware/sdkconfig.defaults
```kconfig
# Partner Test Firmware
# Default configuration

# Enable BLE (NimBLE)
CONFIG_BT_ENABLED=y
CONFIG_BT_NIMBLE_ENABLED=y
CONFIG_BT_NIMBLE_MAX_CONNECTIONS=1
CONFIG_BT_NIMBLE_ROLE_CENTRAL=n
CONFIG_BT_NIMBLE_ROLE_PERIPHERAL=y
CONFIG_BT_NIMBLE_ROLE_BROADCASTER=y
CONFIG_BT_NIMBLE_ROLE_OBSERVER=n

# Task stack
CONFIG_BT_NIMBLE_TASK_STACK_SIZE=4096

# Flash size
CONFIG_ESPTOOLPY_FLASHSIZE_4MB=y

# Logging
CONFIG_LOG_DEFAULT_LEVEL_INFO=y

# FreeRTOS
CONFIG_FREERTOS_HZ=1000
```
